## sdkconfig.defaults
```kconfig
# ESP-Claw Minimal with WeChat - sdkconfig defaults
# ESP-IDF 6.0.1

# Partition table: custom 16MB layout (W25Q128)
CONFIG_PARTITION_TABLE_CUSTOM=y
CONFIG_PARTITION_TABLE_CUSTOM_FILENAME="partitions_16MB.csv"
CONFIG_PARTITION_TABLE_OFFSET=0x9000
CONFIG_ESPTOOLPY_FLASHSIZE_16MB=y

# Disable all unnecessary capabilities - only QQ + core
# CONFIG_APP_CLAW_CAP_AGENT_MGR is not set
# CONFIG_APP_CLAW_CAP_FILES is not set
# CONFIG_APP_CLAW_CAP_IM_FEISHU is not set
# CONFIG_APP_CLAW_CAP_IM_TG is not set
CONFIG_APP_CLAW_CAP_IM_WECHAT=y
# CONFIG_APP_CLAW_CAP_IM_LOCAL is not set
# CONFIG_APP_CLAW_CAP_LLM_INSPECT is not set
# CONFIG_APP_CLAW_CAP_LUA is not set
# CONFIG_APP_CLAW_CAP_MCP_CLIENT is not set
# CONFIG_APP_CLAW_CAP_ROUTER_MGR is not set
# CONFIG_APP_CLAW_CAP_SCHEDULER is not set
# CONFIG_APP_CLAW_CAP_SESSION_MGR is not set
# CONFIG_APP_CLAW_CAP_SKILL_MGR is not set
# CONFIG_APP_CLAW_CAP_SYSTEM is not set
# CONFIG_APP_CLAW_CAP_HTTP_REQUEST is not set
# CONFIG_APP_CLAW_CAP_WEB_SEARCH is not set
# CONFIG_APP_CLAW_ENABLE_CLI is not set
# CONFIG_APP_CLAW_ENABLE_EMOTE is not set
# CONFIG_APP_CLAW_LUA_MODULE_HTTP_SERVER is not set

# HTTPD WebSocket support
CONFIG_HTTPD_WS_SUPPORT=y

# FATFS
CONFIG_FATFS_LFN_HEAP=y
CONFIG_FATFS_VOLUME_COUNT=3

# FreeRTOS
CONFIG_FREERTOS_HZ=100

# SPI RAM / PSRAM settings (ESP32-S3)
CONFIG_SPIRAM_ALLOW_BSS_SEG_EXTERNAL_MEMORY=y
CONFIG_SPIRAM_ALLOW_NOINIT_SEG_EXTERNAL_MEMORY=y
CONFIG_SPIRAM_MEMTEST=n
CONFIG_SPIRAM_MALLOC_ALWAYSINTERNAL=0
CONFIG_SPIRAM_TRY_ALLOCATE_WIFI_LWIP=y

# LWIP
CONFIG_LWIP_LOCAL_HOSTNAME="esp-claw"
CONFIG_LWIP_MAX_SOCKETS=20
CONFIG_LWIP_SNTP_MAX_SERVERS=2

# WiFi
CONFIG_ESP_WIFI_STATIC_RX_BUFFER_NUM=3
CONFIG_ESP_WIFI_DYNAMIC_RX_BUFFER_NUM=6
CONFIG_ESP_WIFI_RX_BA_WIN=3
CONFIG_ESP_WIFI_IRAM_OPT=n
CONFIG_ESP_WIFI_RX_IRAM_OPT=n

# mbedTLS - reduce buffer sizes to allow more concurrent SSL connections
CONFIG_MBEDTLS_EXTERNAL_MEM_ALLOC=y
CONFIG_MBEDTLS_HARDWARE_AES=n
CONFIG_MBEDTLS_SSL_IN_CONTENT_LEN=8192
CONFIG_MBEDTLS_SSL_OUT_CONTENT_LEN=8192

# Main task
CONFIG_ESP_MAIN_TASK_STACK_SIZE=16384

# VFS
CONFIG_VFS_MAX_COUNT=12

# Experimental features
CONFIG_IDF_EXPERIMENTAL_FEATURES=y

# ESP-Claw Core verbosity (disabled for lower RAM/CPU)
# CONFIG_CLAW_CORE_STAGE_VERBOSITY_VERBOSE is not set
```
